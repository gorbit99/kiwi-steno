## boards/shields/kiwi/Kconfig.defconfig
```kconfig
if SHIELD_KIWI_LEFT

config ZMK_KEYBOARD_NAME
  default "Kiwi"

config ZMK_SPLIT_ROLE_CENTRAL
  default y

endif

if SHIELD_KIWI_LEFT || SHIELD_KIWI_RIGHT

config ZMK_SPLIT
  default y

endif
```

## boards/shields/kiwi/Kconfig.shield
```kconfig
config SHIELD_KIWI_LEFT
    def_bool $(shields_list_contains,kiwi_left)

config SHIELD_KIWI_RIGHT
    def_bool $(shields_list_contains,kiwi_right)
```

## config/west.yml
```yaml
manifest:
  remotes:
    - name: zmkfirmware
      url-base: https://github.com/zmkfirmware
    - name: caksoylar
      url-base: https://github.com/caksoylar
    - name: petejohanson
      url-base: https://github.com/petejohanson
  projects:
    - name: zmk
      remote: petejohanson
      revision: features/soft-off-take-3
      import: app/west.yml
    - name: zmk-rgbled-widget
      remote: caksoylar
      revision: main
  self:
    path: config
```
